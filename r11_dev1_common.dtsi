/*
 * Google R11 common DTSI file
 *
 * Copyright 2020 Google LLC
 *
 * This program is free software; you can redistribute it and/or modify
 * it under the terms of the GNU General Public License version 2 and
 * only version 2 as published by the Free Software Foundation.
 *
 * This program is distributed in the hope that it will be useful,
 * but WITHOUT ANY WARRANTY; without even the implied warranty of
 * MERCHANTABILITY or FITNESS FOR A PARTICULAR PURPOSE.  See the
 * GNU General Public License for more details.
 */

#include "r11_common.dtsi"
#include "r11_adc.dtsi"
/* #include "r11_bcm430132_bluetooth.dtsi" */
/* #include "r11_bcm430132_wifi.dtsi" */
#include "r11_bcm47765_gnss.dtsi"
#include "r11_dev1_audio_haptics.dtsi"
#include "r11_dev1_wlc.dtsi"
#include "r11_nanohub.dtsi"
#include "r11_dev1_crown.dtsi"
#include "r11_adc.dtsi"

&regulators {
	ldo22_reg: LDO22 {
		regulator-name = "vdd_ldo22";
		regulator-min-microvolt = <1800000>;
		regulator-max-microvolt = <3375000>;
		regulator-ramp-delay = <12000>;
	};
};
