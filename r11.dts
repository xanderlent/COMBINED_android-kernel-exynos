#include "exynos9110.dts"

#include "exynos9110/r11_st21_nfc.dtsi"
#include "exynos9110/r11_spi0_st54_ese.dtsi"
#include "exynos9110/r11_spi4_st54_ese.dtsi"
#include "exynos9110/r11_cp.dtsi"
#include "exynos9110/r11_common.dtsi"
#include "exynos9110/r11_adc.dtsi"
#include "exynos9110/r11_bcm430132_bluetooth.dtsi"
#include "exynos9110/r11_bcm430132_wifi.dtsi"
#include "exynos9110/r11_bcm47765_gnss.dtsi"
#include "exynos9110/r11_audio_haptics.dtsi"
#include "exynos9110/r11_boe_display_lcd.dtsi"
#include "exynos9110/r11_auo_display_lcd.dtsi"
#include "exynos9110/r11_spi0_nanohub.dtsi"
#include "exynos9110/r11_spi4_nanohub.dtsi"
#include "exynos9110/r11_novatek_touchscreen.dtsi"
#include "exynos9110/r11_raydium_touchscreen.dtsi"
#include "exynos9110/r11_dev2_wlc.dtsi"
#include "exynos9110/r11_proto1_wlc.dtsi"
#include "exynos9110/r11_evt1_wlc.dtsi"
#include "exynos9110/r11_dev2_crown.dtsi"
#include "exynos9110/r11_proto1_crown.dtsi"

/ {
	chosen {
		bootargs = "earlycon=exynos4210,0x13820000 console=ttySAC0,115200 ecd_setup=disable sec_debug.cp=0 androidboot.selinux=permissive";
	};
};

/ {
#include "exynos9110/r11_battery_root.dtsi"
};

/ {
#include "exynos9110/r11_common_root.dtsi"
};
