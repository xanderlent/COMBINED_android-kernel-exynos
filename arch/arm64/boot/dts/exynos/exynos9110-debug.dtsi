/*
 * copyright (c) 2019 samsung electronics co., ltd.
 *		http://www.samsung.com
 *
 * this program is free software; you can redistribute it and/or modify
 * it under the terms of the gnu general public license version 2 as
 * published by the free software foundation.
 */

#include <dt-bindings/soc/samsung/debug-snapshot-def.h>
#include "dpm/exynos-dpm.dtsi"

/ {
	dss: dss {
		compatible = "samsung,debug-snapshot";
		panic_to_wdt = <0>;
		/* devfreq engineer fill freq_names. */
		freq_names = "LIT", "BIG", "INT", "MIF", "ISP", "DISP",
			     "INTCAM", "AUD", "DSP", "DNC", "MFC",
			     "NPU", "TNR", "G3D";
		memory-region = <&header>, <&log_kernel>,
				<&log_platform>, <&log_kevents>;
	};

	dss-qdump {
		compatible = "debug-snapshot,qdump";
	};

	dss-sfrdump {
		compatible = "debug-snapshot,sfrdump";
		/* -----------<< Example >>-------------------
		dump-info {
			#address-cells = <1>;
			#size-cells = <1>;

			gic-setenable {
				reg = <0x11f01100 0x100>;
			};
			gic-setpend {
				reg = <0x11f01200 0x100>;
			};
			gic-setactive {
				reg = <0x11f01300 0x100>;
			};
		};
		*/
	};
};
