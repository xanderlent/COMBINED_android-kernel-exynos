## sound/r11_sound_card/Kconfig
```kconfig
config SND_SOC_R11_SOUND_CARD
	tristate "ASOC R11 sound card (machine) driver"
	help
	  ASOC R11 sound card (machine) driver
```

## sound/soc/mcu_mic_codec/Kconfig
```kconfig
config SND_SOC_MCU_MIC_CODEC
    tristate "ASOC MCU Mic codec"
    depends on PIXEL_WATCH_NANOHUB
    help
    	  ASOC Codec driver to communicate with Microphone on MCU.
```
