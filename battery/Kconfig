## battery/Kconfig
```kconfig
config BATTERY_GOOGLE
	tristate "Google battery driver"
	help
	  Say Y here to enable support for Google battery driver.
```

## bluetooth/Kconfig
```kconfig
comment "Broadcom bluetooth module"

config BT_BRCM_RFKILL
	tristate "Broadcomm rfkill driver"
	depends on BT
	help
	  This enables the Bluetooth driver for Broadcomm's BT/FM/WLAN
	  combo devices. This makes use of shared transport line discipline
	  core driver to communicate with the BT core of the combo chip.

	  Say Y here to compile support for Broadcomm's BCM43455 rfkill driver
	  into the kernel or say M to compile it as module.

config BT_BRCM_LPM
	tristate "Broadcomm BCM43456 LPM driver"
	depends on BT_BRCM_RFKILL
	help
	  This enables the Bluetooth driver for Broadcomm's BT/FM/WLAN
	  combo devices. This makes use of shared transport line discipline
	  core driver to communicate with the BT core of the combo chip.

	  Say Y here to compile support for Broadcomm's BCM43455 LPM driver
	  into the kernel or say M to compile it as module.
```

## drivers/bts/Kconfig
```kconfig
#
# BTS device driver Kernel Configuration
#

menuconfig EXYNOS_BTS
	bool "BTS device driver support"
	help
	  Enables BTS(Bus Traffic Shaper) device driver support
	  BTS device driver will set BTS and request DVFS for
	  controlling system bus traffic. Default setting of BTS
	  should be different to chipset because of hardware characteristics.

if EXYNOS_BTS

config EXYNOS9110_BTS
        bool "Bus traffic shaper support for exynos3830"
        default y
        depends on SOC_EXYNOS9110
        help
          Enable BTS (Bus traffic shaper) support for exynos9110

endif
```

## drivers/gud/Kconfig
```kconfig
#
# Mobicore Configuration
#

if SOC_EXYNOS9110
source "drivers/gud/gud-exynos9110/Kconfig"
endif
```

## drivers/gud/gud-exynos9110/Kconfig
```kconfig
#
# Trustonic drivers configuration
#
config TRUSTONIC_TEE
    tristate "Trustonic TEE Driver"
    depends on ARM || ARM64
    default y
    ---help---
      Enable Trustonic TEE support

config TRUSTONIC_TEE_DEBUG
    bool "Trustonic TEE driver debug mode"
    depends on TRUSTONIC_TEE
    default n
    ---help---
      Enable the debug mode in the Trustonic TEE Driver.

config TRUSTONIC_TRUSTED_UI
    tristate "Trustonic Trusted UI"
    depends on TRUSTONIC_TEE
    default m
    ---help---
      Enable Trustonic Trusted User Interface

config TRUSTONIC_TRUSTED_UI_FB_BLANK
    bool "Trustonic Trusted UI with fb_blank"
    depends on TRUSTONIC_TRUSTED_UI
    ---help---
    Blank the framebuffer before starting a TUI session

#ExySp
source "drivers/gud/gud-exynos9110/sec-os-ctrl/Kconfig"
source "drivers/gud/gud-exynos9110/sec-os-booster/Kconfig"
```

## drivers/input/misc/cs40l2x/Kconfig
```kconfig
config HAPTICS_CS40L2X
	tristate "Cirrus Logic CS40L20/CS40L25/CS40L25A/CS40L25B haptics driver"
	depends on I2C && SYSFS && NEW_LEDS
	help
	 Say Y or M here for the Cirrus Logic CS40L2X haptics driver.
```

## drivers/misc/bcm477xx/Kconfig
```kconfig
#
# Global Navigation Satellite System (GNSS) devices
#

comment "Broadcom BCM477XX module"

config GPS_BCM477XX
    tristate "Broadcom BCM477XX GNSS and sensor hub chip"
    help
        Google Pixel Watch GPS and sensor hub driver.

config GPS_BCM_SENSORS_SSP
    bool "SPI"
    depends on SPI
    help
        ssp driver for sensor hub.
        If you say yes here you get ssp support for
        the sensor hub.
        To compile this driver as a module, choose M here: the
        module will be called ssp.
        This description doesn't seem to match reality.

config GPS_BCM_TTY
    bool  "TTY"
    depends on TTY
    help
        Support for BCM GPS UART driver.
        Driver sources missing.

config GPS_BCM_I2C
    bool "I2C"
    depends on I2C
    help
        Support for BCM GPS I2C driver.
        Driver sources missing.

config BCM_GPS_SPI_DRIVER
    bool "SPI"
    depends on SPI
    help
        Support for BCM GPS SPI driver.

config GPS_BCM_HOSTWAKE
    bool "Hostwake"
    help
        Purpose unknown. Driver sources missing.
```

## drivers/misc/pixel_watch_nanohub/Kconfig
```kconfig
config PIXEL_WATCH_NANOHUB
	tristate "Pixel Watch Nanohub"
	select IIO
	default N
	# In-tree Samsung NANOHUB driver in drivers/staging/nanohub is NOT what we want
	depends on !NANOHUB
	# TODO: This driver depends on some Samsung SoC stuff?
	help
	  Enable support for the nanohub sensorhub driver for the Google Pixel Watch.

	  This driver supports the android nanohub sensorhub.

	  If in doubt, say N here.

if PIXEL_WATCH_NANOHUB

config PIXEL_WATCH_NANOHUB_SPI
	bool "Pixel Watch Nanohub SPI"
	default Y
	help
	  Enable nanohub SPI support for the Google Pixel Watch.

	  If in doubt, say Y here.

config PIXEL_WATCH_NANOHUB_BL_NXP
	bool "Pixel Watch Nanohub NXP Bootloader"
	default Y
	help
	  Enable nanohub NXP Bootloader support for the Google Pixel Watch.

	  Mutually exclusive with PIXEL_WATCH_NANOHUB_BL_ST.

	  If in doubt, say Y here.

config PIXEL_WATCH_NANOHUB_BL_ST
	bool "Pixel Watch Nanohub ST Bootloader"
	default N
	depends on !PIXEL_WATCH_NANOHUB_BL_NXP
	help
	  Enable nanohub ST Bootloader support for the Google Pixel Watch.

	  Mutually exclusive with PIXEL_WATCH_NANOHUB_BL_NXP.

	  If in doubt, say N here.

endif # PIXEL_WATCH_NANOHUB
```

## drivers/nfc/st54j/Kconfig
```kconfig
#
# Near Field Communication (NFC) devices
#

comment "ST Microelectronics NFC54 module"

config NFC_ST21NFC
        tristate "ST Microelectronics ST21NFC NFC Controller Driver"
        depends on I2C
        help
	  ST Microelectronics ST21NFC Near Field Communication controller support.

config ESE_ST54J
	tristate "ST Microelectronics ST54J ESE driver"
	depends on SPI && NFC_ST21NFC
	help
	  ST Microelectronics ST54J ESE Near Field Communication controller support.
```

## drivers/power/Kconfig
```kconfig
source "drivers/power/avs/Kconfig"
source "drivers/power/reset/Kconfig"
source "drivers/power/supply/Kconfig"

source "drivers/power/battery/Kconfig"

config NITROUS
	tristate "Nitrous Oxide Driver for Bluetooth"
	help
	 The Google Pixel Watch version of the Google Nitrous Bluetooth Power Management driver.

source "drivers/power/wlc/Kconfig"
```

## drivers/power/battery/Kconfig
```kconfig
config BATTERY_GOOGLE
	tristate "Google battery driver"
	help
	  Say Y here to enable support for Google battery driver.

config NTC_GOOGLE
	tristate "Google NTC driver"
	help
	  Say Y here to enable support for Google NTC driver.
```

## drivers/soc/samsung/debug/Kconfig
```kconfig
menuconfig EXYNOS_DEBUG
        bool "Exynos Debug Features"
        default n

if EXYNOS_DEBUG
menuconfig DEBUG_SNAPSHOT
	tristate "Debug SnapShot Support"
	depends on EXYNOS_DEBUG
	default n

config DEBUG_SNAPSHOT_FREQ_DOMAIN_NUM
	int "Number of freq logging domain type"
	depends on DEBUG_SNAPSHOT
	range 4 32
	default 32

config DEBUG_SNAPSHOT_LOG_ITEM_SIZE
	int "Number of logging item base size"
	depends on DEBUG_SNAPSHOT
	range 256 1024
	default 1024

config DEBUG_SNAPSHOT_SFRDUMP
	tristate "Debug Snapshot SFRDUMP"
	depends on DEBUG_SNAPSHOT
	default n

config DEBUG_SNAPSHOT_QUICKDUMP
	tristate "Debug Snapshot quickdump"
	depends on DEBUG_SNAPSHOT
	default n

config EXYNOS_ITMON
        bool "Exynos IPs Traffic Monitor"
        depends on EXYNOS_DEBUG
        default n
endif
```

## gnss/bcm477xx/Kconfig
```kconfig
#
# Global Navigation Satellite System (GNSS) devices
#

comment "Broadcom BCM477XX module"

config GPS_BCM_SENSORS_SSP
    bool "SPI"
    depends on SPI
    help
        ssp driver for sensor hub.
        If you say yes here you get ssp support for
        the sensor hub.
        To compile this driver as a module, choose M here: the
        module will be called ssp.

config GPS_BCM_TTY
    bool  "TTY"
    depends on TTY
    help
        Support for BCM GPS UART driver.

config GPS_BCM_I2C
    bool "I2C"
    depends on I2C
    help
        Support for BCM GPS I2C driver.

config GPS_BCM_SPI
    bool "SPI"
    depends on SPI
    help
        Support for BCM GPS SPI driver.
```

## haptics/cs40l2x/Kconfig
```kconfig
config CS40L2X_HAPTIC
	tristate "Cirrus Logic CS40L2X haptics support"
	depends on I2C
	depends on LEDS
	select REGMAP_I2C
	help
	  Say Y to enable support for the CS CS40L2X haptics driver.

	  To compile this driver as a module, choose M here.
```

## input/misc/ots_pat9150/Kconfig
```kconfig
#
# PixArt OTS switch driver configuration
#

config INPUT_PIXART_OTS_PAT9150_SWITCH
	tristate "PixArt PAT9150 Rotating Switch driver"
	depends on INPUT && I2C && GPIOLIB
	help
	  Say Y to enable support for the PixArt OTS pat9150
	  rotating switch driver.
	  If unsure, say N.

	  To compile this driver as a module, choose M here: the
	  module will be called ots_pat9150.
```

## input/touchscreen/Kconfig
```kconfig
comment "Raydium touchscreen module"

config TOUCHSCREEN_RAYDIUM
	tristate "Raydium touchscreen driver"

config TOUCHSCREEN_RAYDIUM_UPDATE_FW
	bool "Automatically update touch firmware"
	default y
```

## out-of-tree-drivers/haptics/cs40l2x/Kconfig
```kconfig
config HAPTICS_CS40L2X
	tristate "Cirrus Logic CS40L20/CS40L25/CS40L25A/CS40L25B haptics driver"
	depends on I2C && SYSFS && NEW_LEDS
	help
```

## out-of-tree-drivers/input/touchscreen/nt38350/Kconfig
```kconfig
#
# Novatek NT38350 touchscreen driver configuration
#
config TOUCHSCREEN_NT38350
	bool "Novatek NT38350"
	default y
	help
	  Say Y here if you have a Novatek NT38350 touchscreen connected
	  to your system.

	  If unsure, say N.
```

## out-of-tree-drivers/input/touchscreen/raydium/Kconfig
```kconfig
comment "Raydium touchscreen module"

config TOUCHSCREEN_RAYDIUM
	tristate "Raydium touchscreen driver"
```

## out-of-tree-drivers/nfc/Kconfig
```kconfig
#
# Near Field Communication (NFC) devices
#

comment "ST Microelectronics NFC54 module"

config NFC_ST21NFC
        bool "ST Microelectronics ST21NFC NFC Controller Driver"
        depends on I2C
        help
	  ST Microelectronics ST21NFC Near Field Communication controller support.

config ESE_ST54J
	bool "ST Microelectronics ST54J ESE driver"
	depends on SPI && NFC_ST21NFC
	help
	  ST Microelectronics ST54J ESE Near Field Communication controller support.
```

## out-of-tree-drivers/rtc/Kconfig
```kconfig
config RTC_DRV_S3C_ALT
	bool "Samsung S3C series SoC RTC (Alternate Driver)"
	depends on ARCH_S3C64XX || HAVE_S3C_RTC || COMPILE_TEST
	help
	  This alternate driver for the Samsung S3C RTC driver does
	  not register with the Linux RTC framework and instead acts
	  as a persistent clock source for timekeeping across suspend.
```

## out-of-tree-drivers/wlc/Kconfig
```kconfig
comment "Halo Microelectronics HL6111R charger"

config WLC_HL6111R
		tristate "Halo Microelectronics HL6111R Wireless Power Receiver Driver"
		depends on I2C
```
